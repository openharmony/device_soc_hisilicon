## ws63v100/sdk/drivers/drivers/hal/efuse/Kconfig
```kconfig
#===============================================================================
# @brief    Kconfig file.
# Copyright (c) 2020 HiSilicon (Shanghai) Technologies CO., LIMITED.
#===============================================================================
config EFUSE_USING_V151
    bool
    prompt "Using EFUSE V151"
    default y
    depends on DRIVER_SUPPORT_EFUSE

config EFUSE_SWITCH_EN
    bool
    prompt "Using EFUSE SWITCH EN"
    default n
    depends on DRIVER_SUPPORT_EFUSE

config EFUSE_REGION_NUM
    int
    prompt "Max REGION of the EFUSE"
    range 1 3
    default 1
    depends on EFUSE_USING_V151
```

## ws63v100/sdk/drivers/drivers/hal/pmp/Kconfig
```kconfig
#===============================================================================
# @brief    Kconfig file.
# Copyright (c) 2020 HiSilicon (Shanghai) Technologies CO., LIMITED.
#===============================================================================
config PMP_USING_RISCV_31
    bool
    prompt "Using the RISC-V31"
    default n
    depends on DRIVER_SUPPORT_PMP

config PMP_USING_RISCV_70
    bool
    prompt "Using the RISC-V70"
    default n
    depends on DRIVER_SUPPORT_PMP
```

## ws63v100/sdk/drivers/drivers/hal/sfc/Kconfig
```kconfig
#===============================================================================
# @brief    Kconfig file.
# Copyright (c) 2020 HiSilicon (Shanghai) Technologies CO., LIMITED.
#===============================================================================
config SFC_DEBUG
    bool
    prompt "SFC Support DEBUG"
    default y
    depends on DRIVER_SUPPORT_SFC
```

## ws63v100/sdk/drivers/drivers/hal/spi/Kconfig
```kconfig
#===============================================================================
# @brief    Kconfig file.
# Copyright (c) 2020 HiSilicon (Shanghai) Technologies CO., LIMITED.
#===============================================================================
config SPI_USING_V100
    bool
    prompt "Using SPI V100."
    default y
    depends on DRIVER_SUPPORT_SPI

config SPI_USING_V151
    bool
    prompt "Using SPI V151."
    default y
    depends on DRIVER_SUPPORT_SPI
```

## ws63v100/sdk/drivers/drivers/hal/tsensor/Kconfig
```kconfig
#===============================================================================
# @brief    Kconfig file.
# Copyright (c) 2020 HiSilicon (Shanghai) Technologies CO., LIMITED.
#===============================================================================
config TSENSOR_USING_V150
    bool
    prompt "Using Tsensor V150"
    default y
    depends on DRIVER_SUPPORT_TSENSOR

config TSENSOR_USING_V151
    bool
    prompt "Using Tsensor V151"
    default y
    depends on DRIVER_SUPPORT_TSENSOR

config TSENSOR_TEMP_COMPENSATION
    bool
    prompt "Switch of temperature compensation in Tsensor"
    default y
    depends on DRIVER_SUPPORT_TSENSOR

config TSENSOR_DELAY_TIME
    int
    prompt "Reporting delay time of Tsensor"
    range 0 3
    default 1
    depends on DRIVER_SUPPORT_TSENSOR

config TSENSOR_WAIT_TIME_MS
    int
    prompt "Wait time of Tsensor get temperature"
    default 5
    depends on DRIVER_SUPPORT_TSENSOR

config TSENSOR_MULTILEVEL
    bool
    prompt "Switch of Multi-level temperature in Tsensor"
    default y
    depends on DRIVER_SUPPORT_TSENSOR
```

## ws63v100/sdk/kernel/Kconfig
```kconfig
#===============================================================================
# @brief    Kconfig file.
# Copyright (c) 2020 HiSilicon (Shanghai) Technologies CO., LIMITED.
#===============================================================================
config DRIVER_SUPPORT_LITEOS
    bool
    prompt "Use LiteOS"
    default y
    help
        This option means support LiteOS.

if DRIVER_SUPPORT_LITEOS
    source "kernel/liteos/Kconfig"
endif

menu "osal"
    comment "Config osal."
    osource "kernel/osal/Kconfig"
endmenu
```

## ws63v100/sdk/kernel/osal/Kconfig
```kconfig
#===============================================================================
# @brief    Kconfig file.
# Copyright (c) 2020 HiSilicon (Shanghai) Technologies CO., LIMITED.
#===============================================================================
config DRIVER_DISABLE_OSAL_LOG
    bool
    prompt "disable osal log"
    default n
    help
        This option means turn off osal log.
```

## ws63v100/sdk/middleware/Kconfig
```kconfig
#===============================================================================
# @brief    Kconfig file.
# Copyright (c) 2020 HiSilicon (Shanghai) Technologies CO., LIMITED.
#===============================================================================
menu "Chips"
    comment "Config the middleware of chips."
    osource "middleware/chips/Kconfig"
endmenu

menu "Services"
    comment "Config the middleware of service."
    osource "middleware/services/Kconfig"
endmenu

menu "Utils"
    comment "Config the middleware of utils."
    osource "middleware/utils/Kconfig"
endmenu
```

## ws63v100/sdk/middleware/utils/dfx/Kconfig
```kconfig
#===============================================================================
# @brief    Kconfig file.
# Copyright (c) 2020 HiSilicon (Shanghai) Technologies CO., LIMITED.
#===============================================================================
config DFX_SUPPORT_USERS_PRINT
    bool
    prompt "ENABLE USER TO REGISTER LOG API."
    default y
    depends on MIDDLEWARE_SUPPORT_DFX
config DFX_SUPPORT_PRINT
    bool
    prompt "dfx print with level limit"
    default n
    depends on MIDDLEWARE_SUPPORT_DFX
```

## ws63v100/sdk/protocol/bt/host/Kconfig
```kconfig
#===============================================================================
# @brief    Kconfig file.
# Copyright (c) 2020 HiSilicon (Shanghai) Technologies CO., LIMITED.
#===============================================================================
config AT_BLE
    bool
    prompt "Support AT BLE function."
    default y

if AT_BLE
menu "AT_BLE"
    comment "Config bluetooth host AT BLE."
    osource "protocol/bt/host/bt/dft/Kconfig"
endmenu
endif

config AT_GLE
    bool
    prompt "Support AT GLE function."
    default y

if AT_GLE
menu "AT_GLE"
    comment "Config bluetooth host AT GLE."
    osource "protocol/bt/host/gle/dft/Kconfig"
endmenu
endif

menu "FEATURE_GLE"
    comment "Config bluetooth host GLE feature."
    osource "protocol/bt/host/gle/Kconfig"
endmenu
```

## ws63v100/sdk/protocol/bt/host/gle/Kconfig
```kconfig
#===============================================================================
# @brief    SLE feature config.
# Copyright (c) 2020 HiSilicon (Shanghai) Technologies CO., LIMITED.
#===============================================================================
config FEATURE_GLE_LOW_LATENCY
    bool
    prompt "Using gle low latency feature."
    default n

config FEATURE_GLE_HADM
    bool
    prompt "Using gle hadm feature."
    default n
```

## ws63v100/sdk/protocol/radar/plat/Kconfig
```kconfig
#===============================================================================
# @brief    Kconfig file.
# Copyright (c) 2020 HiSilicon (Shanghai) Technologies CO., LIMITED.
#===============================================================================
config RADAR_DBG
    bool
    prompt "Enable Radar Dbg."
    default n
    help
        This option means support Radar Dbg.

config RADAR_AI
    bool
    prompt "Enable Radar AI."
    default n
    help
        This option means support Radar AI.

config RADAR_MFG
    bool
    prompt "Enable Radar MFG."
    default n
    help
        This option means support Radar MFG.

config RADAR_MIPS
    bool
    prompt "Enable Radar MIPS."
    default n
    help
        This option means support Radar MIPS.
```
