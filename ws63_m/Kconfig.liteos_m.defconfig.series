## ws63_m/Kconfig.liteos_m.series
```kconfig
config SOC_SERIES_WS63
    bool "HiSilicon WS63 Series"
    depends on PLATFORM_WS63_M
    select ARCH_RISCV32
    select SOC_COMPANY_HISILICON
    help
        Enable support for HiSilicon WS63 Series

config SOC_COMPANY
    string
    default "hisilicon" if PLATFORM_WS63_M
```

## ws63_m/Kconfig.liteos_m.soc
```kconfig
choice
    prompt "WS63 series SoC"
    depends on SOC_SERIES_WS63

config SOC_WS63V100
    bool "SoC WS63V100"
    default y

endchoice
```
