## hi3751v350/sdk_linux/source/msp/drv/gt911/Kconfig
```kconfig
#
# v350 gt911 drivers configuration
#

menu "v350 gt911 drivers support"

config HI_GT911
	tristate "HI GT911" 
	help
	  This is the  GT911 driver for v350 touch.
	  
endmenu
```

## ws63v100/sdk/application/Kconfig
```kconfig
#===============================================================================
# @brief    Kconfig file.
# Copyright (c) 2020 HiSilicon (Shanghai) Technologies CO., LIMITED.
#===============================================================================

config SAMPLE_ENABLE
    bool
    prompt "Enable Sample."
    default n
    help
        This option means support Samples.

if SAMPLE_ENABLE
osource "application/samples/Kconfig"
endif
```

## ws63v100/sdk/application/samples/bt/Kconfig
```kconfig
#===============================================================================
# @brief    Kconfig file.
# Copyright (c) 2020 HiSilicon (Shanghai) Technologies CO., LIMITED.
#===============================================================================
choice
    prompt "Sample"

config SAMPLE_SUPPORT_BLE_SAMPLE
    bool "Support BLE Sample."

if SAMPLE_SUPPORT_BLE_SAMPLE
osource "application/samples/bt/ble/Kconfig"
endif

config SAMPLE_SUPPORT_SLE_SAMPLE
    bool "Support SLE Sample."
endchoice

if SAMPLE_SUPPORT_SLE_SAMPLE
osource "application/samples/bt/sle/Kconfig"
endif
```

## ws63v100/sdk/application/samples/bt/ble/Kconfig
```kconfig
#===============================================================================
# @brief    Kconfig file.
# Copyright (c) 2020 HiSilicon (Shanghai) Technologies CO., LIMITED.
#===============================================================================

choice
    prompt "BLE Sample"

config SAMPLE_SUPPORT_BLE_GATT_CLIENT_SAMPLE
    bool "Support BLE GATT Client Sample."

config SAMPLE_SUPPORT_BLE_GATT_SERVER_SAMPLE
    bool "Support BLE GATT Server Sample."

config SAMPLE_SUPPORT_BLE_SPEED_SERVER_SAMPLE
    bool "Support BLE Throughput Server Sample."

config SAMPLE_SUPPORT_BLE_SPEED_CLIENT_SAMPLE
    bool "Support BLE Throughput Client Sample"

endchoice
```

## ws63v100/sdk/application/samples/bt/sle/Kconfig
```kconfig
#===============================================================================
# @brief    Kconfig file.
# Copyright (c) 2020 HiSilicon (Shanghai) Technologies CO., LIMITED.
#===============================================================================

choice
    prompt "SLE Sample"

config SAMPLE_SUPPORT_SLE_UUID_SERVER_SAMPLE
    bool "Support SLE UUID Server Sample."

config SAMPLE_SUPPORT_SLE_UUID_CLIENT_SAMPLE
    bool "Support SLE UUID Client Sample."

config SAMPLE_SUPPORT_SLE_SPEED_SERVER_SAMPLE
    bool "Support SLE Throughput Server Sample."

config SAMPLE_SUPPORT_SLE_SPEED_CLIENT_SAMPLE
    bool "Support SLE Throughput Client Sample."

endchoice
```

## ws63v100/sdk/application/samples/peripheral/dma/Kconfig
```kconfig
#===============================================================================
# @brief    Kconfig file.
# Copyright (c) 2020 HiSilicon (Shanghai) Technologies CO., LIMITED.
#===============================================================================
config DMA_MEMORY_LLI_TRANSFER_MODE
    bool
    prompt "Choose DMA memory to memory lli transfer mode."
    depends on SAMPLE_SUPPORT_DMA
    default n
```

## ws63v100/sdk/application/samples/peripheral/pinctrl/Kconfig
```kconfig
#===============================================================================
# @brief    Kconfig file.
# Copyright (c) 2020 HiSilicon (Shanghai) Technologies CO., LIMITED.
#===============================================================================
config PINCTRL_USE_PIN
    int
    prompt "Choose Pinctrl use pin."
    depends on SAMPLE_SUPPORT_PINCTRL
    default 23
```

## ws63v100/sdk/application/samples/peripheral/pwm/Kconfig
```kconfig
#===============================================================================
# @brief    Kconfig file.
# Copyright (c) 2020 HiSilicon (Shanghai) Technologies CO., LIMITED.
#===============================================================================
config PWM_CHANNEL
    int
    prompt "Choose PWM Test Channel."
    depends on SAMPLE_SUPPORT_PWM
    default 0

config PWM_GROUP_ID
    int
    prompt "Choose PWM Test Group ID."
    depends on SAMPLE_SUPPORT_PWM && PWM_USING_V151
    default 0

config PWM_PIN
    int
    prompt "Choose PWM pin."
    depends on SAMPLE_SUPPORT_PWM
    default 20

config PWM_PIN_MODE
    int
    prompt "Choose PWM pin mode."
    default 3
    depends on SAMPLE_SUPPORT_PWM
```

## ws63v100/sdk/application/samples/peripheral/sfc/Kconfig
```kconfig
#===============================================================================
# @brief    Kconfig file.
# Copyright (c) 2020 HiSilicon (Shanghai) Technologies CO., LIMITED.
#===============================================================================
config SFC_SAMPLE_USER_ADDR
    hex
    prompt "choose SFC sample Start Address(Real address of the flash memory)."
    depends on SAMPLE_SUPPORT_SFC
    default 0x7C000

config SFC_SAMPLE_USER_SIZE
    hex
    prompt "choose SFC sample End Address(Real address of the flash memory)."
    depends on SAMPLE_SUPPORT_SFC
    default 0x1000
```

## ws63v100/sdk/application/samples/peripheral/watchdog/Kconfig
```kconfig
#===============================================================================
# @brief    Kconfig file.
# Copyright (c) 2020 HiSilicon (Shanghai) Technologies CO., LIMITED.
#===============================================================================
config WDT_TIMEOUT_SAMPLE
    bool
    prompt "Choose watchdog kick timeout."
    depends on SAMPLE_SUPPORT_WDT
    default n

config WDT_KICK_SAMPLE
    bool
    prompt "Choose watchdog kick normally."
    depends on SAMPLE_SUPPORT_WDT
    default n
```

## ws63v100/sdk/application/samples/radar/Kconfig
```kconfig
#===============================================================================
# @brief    Kconfig file.
# Copyright (c) 2020 HiSilicon (Shanghai) Technologies CO., LIMITED.
#===============================================================================
choice
    prompt "Sample"

config SUPPORT_RADAR_STA_SAMPLE
    bool "Support RADAR STA Sample"

config SUPPORT_RADAR_SOFTAP_SAMPLE
    bool "Support RADAR SoftAP Sample."
endchoice
```

## ws63v100/sdk/drivers/Kconfig
```kconfig
#===============================================================================
# @brief    Kconfig file.
# Copyright (c) 2020 HiSilicon (Shanghai) Technologies CO., LIMITED.
#===============================================================================
menu "Boards"
    comment "Config the drivers of boards."
    osource "drivers/boards/Kconfig"
endmenu

menu "Chips"
    comment "Config the drivers of chips."
    osource "drivers/chips/Kconfig"
endmenu

menu "Drivers"
    comment "Config the drivers."
    osource "drivers/drivers/Kconfig"
endmenu
```

## ws63v100/sdk/drivers/boards/Kconfig
```kconfig
#===============================================================================
# @brief    Kconfig file.
# Copyright (c) 2020 HiSilicon (Shanghai) Technologies CO., LIMITED.
#===============================================================================

if CHIP_WS53
menu "Boards Configurations for ws53"
    comment "Config ws53"
    osource "drivers/boards/ws53/Kconfig"
endmenu
endif

if CHIP_WS63
menu "Boards Configurations for ws63"
    comment "Config ws63"
    osource "drivers/boards/ws63/Kconfig"
endmenu
endif
```

## ws63v100/sdk/drivers/boards/ws63/Kconfig
```kconfig
#===============================================================================
# @brief    Kconfig file.
# Copyright (c) 2020 HiSilicon (Shanghai) Technologies CO., LIMITED.
#===============================================================================

config MEMORY_CUSTOMIZE_SEC
    bool "Customize sections"
    default n
    --help--
        Turn on this option, a output section will be added

config MEMORY_CUSTOMIZE_RSV
    bool "Customize memory reserve"
    default n
    --help--
        Memory recovery will be turned on
```

## ws63v100/sdk/drivers/chips/Kconfig
```kconfig
#===============================================================================
# @brief    Kconfig file.
# Copyright (c) 2020 HiSilicon (Shanghai) Technologies CO., LIMITED.
#===============================================================================

choice
    prompt "Choose Chip"
    optional

config CHIP_WS53
    bool "ws53"

config CHIP_WS63
    bool "ws63"

endchoice

if CHIP_WS53
menu "Chip Configurations for ws53"
    comment "Config ws53"
    osource "drivers/chips/ws53/Kconfig"
endmenu
endif

if CHIP_WS63
menu "Chip Configurations for ws63"
    comment "Config ws63"
    osource "drivers/chips/ws63/Kconfig"
endmenu
endif
```

## ws63v100/sdk/drivers/chips/ws63/rom/drivers/drivers/driver/timer/Kconfig
```kconfig
#===============================================================================
# @brief    Kconfig file.
# Copyright (c) 2020 HiSilicon (Shanghai) Technologies CO., LIMITED.
#===============================================================================
config TIMER_MAX_TIMERS_NUM
    int
    prompt "Max timers num"
    default 16
    depends on DRIVER_SUPPORT_TIMER

config TIMER_CLOCK_VALUE
    int
    prompt "Timer clock value in Hz."
    default 32000000
    depends on DRIVER_SUPPORT_TIMER
```

## ws63v100/sdk/drivers/chips/ws63/rom/drivers/drivers/driver/watchdog/Kconfig
```kconfig
#===============================================================================
# @brief    Kconfig file.
# Copyright (c) 2020 HiSilicon (Shanghai) Technologies CO., LIMITED.
#===============================================================================
config WATCHDOG_ALREADY_START
    bool
    prompt "Watchdog has been started in another binary."
    default n
    depends on DRIVER_SUPPORT_WDT
```

## ws63v100/sdk/drivers/drivers/driver/dma/Kconfig
```kconfig
#===============================================================================
# @brief    Kconfig file.
# Copyright (c) 2020 HiSilicon (Shanghai) Technologies CO., LIMITED.
#===============================================================================
config DMA_SUPPORT_LLI
    bool
    prompt "DMA Support lli"
    default y
    depends on DRIVER_SUPPORT_DMA

config DMA_SUPPORT_CIRCULAR_LLI
    bool
    prompt "DMA Support circular lli"
    default n
    depends on DMA_SUPPORT_LLI

config DMA_SUPPORT_LPM
    bool
    prompt "DMA Support low power mode"
    default y
    depends on DRIVER_SUPPORT_DMA

config DMA_SUPPORT_QUERY_REGS
    bool
    prompt "DMA support query regs values"
    default n
    depends on DRIVER_SUPPORT_DMA
```

## ws63v100/sdk/drivers/drivers/driver/gpio/Kconfig
```kconfig
#===============================================================================
# @brief    Kconfig file.
# Copyright (c) 2020 HiSilicon (Shanghai) Technologies CO., LIMITED.
#===============================================================================

config GPIO_SUPPORT_LPM
    bool
    prompt "GPIO Support low power mode, supend and reusme"
    default y
    depends on DRIVER_SUPPORT_GPIO

config GPIO_SELECT_CORE
    bool
    prompt "GPIO Support choose to select core"
    default n
    depends on DRIVER_SUPPORT_GPIO
```

## ws63v100/sdk/drivers/drivers/driver/pinmux/Kconfig
```kconfig
#===============================================================================
# @brief    Kconfig file.
# Copyright (c) 2020 HiSilicon (Shanghai) Technologies CO., LIMITED.
#===============================================================================
config PINCTRL_SUPPORT_LPM
    bool
    prompt "PINCTRL Support low power mode, supend and reusme"
    default n
    depends on DRIVER_SUPPORT_PINCTRL
```

## ws63v100/sdk/drivers/drivers/driver/security/hash/Kconfig
```kconfig
#===============================================================================
# @brief    Kconfig file.
# Copyright (c) 2020 HiSilicon (Shanghai) Technologies CO., LIMITED.
#===============================================================================
config HASH_SUPPORT_SHA512
    bool
    prompt "Hash support SHA512"
    default n
    depends on DRIVER_SUPPORT_HASH
```

## ws63v100/sdk/drivers/drivers/driver/systick/Kconfig
```kconfig
#===============================================================================
# @brief    Kconfig file.
# Copyright (c) 2020 HiSilicon (Shanghai) Technologies CO., LIMITED.
#===============================================================================
config SYSTICK_SUPPORT_LPM
    bool
    prompt "Systick Support low power mode, supend and reusme"
    default n
    depends on DRIVER_SUPPORT_SYSTICK
```

## ws63v100/sdk/drivers/drivers/driver/tcxo/Kconfig
```kconfig
#===============================================================================
# @brief    Kconfig file.
# Copyright (c) 2020 HiSilicon (Shanghai) Technologies CO., LIMITED.
#===============================================================================
config TCXO_SUPPORT_LPM
    bool
    prompt "TCXO Support low power mode, supend and reusme"
    default n
    depends on DRIVER_SUPPORT_TCXO
```

## ws63v100/sdk/drivers/drivers/driver/watchdog/Kconfig
```kconfig
#===============================================================================
# @brief    Kconfig file.
# Copyright (c) 2020 HiSilicon (Shanghai) Technologies CO., LIMITED.
#===============================================================================
config WATCHDOG_ALREADY_START
    bool
    prompt "Watchdog has been started in another binary."
    default n
    depends on DRIVER_SUPPORT_WDT

config WATCHDOG_SUPPORT_ULP_WDT
    bool
    prompt "Watch dog support ulp watchdog"
    default n
    depends on DRIVER_SUPPORT_WDT
	
config WATCHDOG_SUPPORT_LPM
    bool
    prompt "Watch dog support low power mode"
    default n
    depends on DRIVER_SUPPORT_WDT
```
